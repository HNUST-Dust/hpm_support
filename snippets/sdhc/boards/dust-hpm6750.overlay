/*
 * Copyright 2024 HPMicro
 * SPDX-License-Identifier: Apache-2.0
 */

/ {
	aliases {
		sdhc0 = &sd0;
	};
};

&sd0 {
	status = "okay";
	pinctrl-0 = <&pinmux_sd>;
	pinctrl-1 = <&pinmux_sd>;
	pinctrl-2 = <&pinmux_sd>;
	pinctrl-3 = <&pinmux_sd>;
	pinctrl-4 = <&pinmux_sd>;
	pinctrl-names = "default", "slow", "med", "fast", "nopull";
	power-delay-ms = <0>;
	pwr-3v3-support;
	embedded-4-bit-support;

	sdmmc {
		compatible = "zephyr,sdmmc-disk";
		status = "okay";
	};
};
