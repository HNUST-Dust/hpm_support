## CMakeLists.txt
```
# SPDX-License-Identifier: Apache-2.0

cmake_minimum_required(VERSION 3.20.0)
find_package(Zephyr REQUIRED HINTS $ENV{ZEPHYR_BASE})
project(ecat)

# _nocache_ram_size is an absolute linker symbol and may legitimately be 0
# when no DMA buffers use __nocache. GCC otherwise assumes its address is
# non-null and removes soc_init_pma()'s zero-size guard. Preserve that guard
# for this BSP source; a zero-size NAPOT region would cover AXI SRAM and
# change the cacheability of the live stack without cleaning dirty data.
if(CONFIG_SOC_HPM5E31 AND CONFIG_NOCACHE_MEMORY)
    set_property(SOURCE
        ${ZEPHYR_SDK_GLUE_MODULE_DIR}/soc/hpmicro/HPM5E00/soc.c
        TARGET_DIRECTORY zephyr APPEND PROPERTY COMPILE_OPTIONS
        -fno-delete-null-pointer-checks)
endif()

target_sources(app PRIVATE src/main.c)

add_subdirectory(Middleware/ESC)
add_subdirectory(EtherCAT)
```

## sample.yaml
```
sample:
  name: ecat
  description: HPM5E31 EtherCAT slave controller (SSC) loopback sample
  platforms:
    - dust-hpm5e31
```

## prj.conf
```kconfig
CONFIG_PRINTK=y
CONFIG_GPIO=y
CONFIG_HPM_ESC=y

# Flash-backed EtherCAT EEPROM; CONFIG_XIP selects code execution from Flash.
CONFIG_FLASH=y
CONFIG_FLASH_MAP=y
CONFIG_XIP=y
```

## src/main.c
```c
/* SPDX-License-Identifier: Apache-2.0 */

#include <zephyr/device.h>
#include <zephyr/kernel.h>
#include <zephyr/sys/printk.h>

#include <hpm_clock_drv.h>

#include "applInterface.h"
#include "digital_io.h"
#include "hpm_ecat_hw.h"
#include "ecat_zephyr_port.h"

BUILD_ASSERT(DT_PROP(DT_NODELABEL(esc0), software_link0),
	     "Port0 link polling requires software-link0");

int main(void)
{
	printk("HPM5E31 EtherCAT Port0 MII\n");
	printk("CPU0 clock: %u Hz, ESC bus clock: %u Hz\n",
	       clock_get_frequency(clock_cpu0), clock_get_frequency(clock_esc0));
	printk("Console UART0 OK\n");

#if 1
	const struct device *esc = ECAT_ESC_DEVICE;
	uint32_t last_link_poll;

	if (!device_is_ready(esc)) {
		printk("ESC device is not ready\n");
		return 0;
	}
	ecat_irq_init();
	if (ecat_hardware_init(esc) != status_success) {
		printk("EtherCAT startup failed: check EEPROM/PHY diagnostics above\n");
		return 0;
	}
	if (MainInit() != 0U) {
		printk("SSC initialization failed\n");
		return 0;
	}
#if defined(ESC_EEPROM_EMULATION) && ESC_EEPROM_EMULATION
	/* MainInit clears these hooks; install them after stack initialization. */
	pAPPL_EEPROM_Read = ecat_eeprom_emulation_read;
	pAPPL_EEPROM_Write = ecat_eeprom_emulation_write;
	pAPPL_EEPROM_Reload = ecat_eeprom_emulation_reload;
	pAPPL_EEPROM_Store = ecat_eeprom_emulation_store;
#endif
	if (APPL_GenerateMapping(&nPdInputSize, &nPdOutputSize) != 0U) {
		printk("EtherCAT PDO mapping failed\n");
		return 0;
	}
	ecat_phy_update_link(esc);
	bRunApplication = TRUE;
	hpm_esc_start(esc);
	printk("EtherCAT SSC running, PDO input/output: %u/%u bytes\n",
	       nPdInputSize, nPdOutputSize);

	last_link_poll = k_uptime_get_32();
	while (bRunApplication == TRUE) {
		MainLoop();
		uint32_t now = k_uptime_get_32();
		if ((uint32_t)(now - last_link_poll) >= 100U) {
			ecat_phy_update_link(esc);
			last_link_poll = now;
		}
	}
	HW_Release();
#endif
	return 0;
}
```
