## boards/hpmicro/dust-hpm5e31/Kconfig.defconfig
```kconfig
if BOARD_DUST_HPM5E31

config HEAP_MEM_POOL_SIZE
	default 16384

config BUILD_OUTPUT_HEX
	default y

config UART_INTERRUPT_DRIVEN
	default y

endif
```

## boards/hpmicro/dust-hpm5e31/dust-hpm5e31_defconfig
```kconfig
CONFIG_CONSOLE=y
CONFIG_UART_CONSOLE=y
CONFIG_XIP=y
CONFIG_PINCTRL=y
CONFIG_GPIO=y
CONFIG_SERIAL=y
CONFIG_DMA=y
CONFIG_SPI=n
CONFIG_CAN=y
CONFIG_PWM=y
CONFIG_HPM_ESC=y
CONFIG_NOCACHE_MEMORY=y
CONFIG_FLASH=y
```

## boards/hpmicro/dust-hpm5e3y/Kconfig.defconfig
```kconfig
if BOARD_DUST_HPM5E3Y

config HEAP_MEM_POOL_SIZE
	default 16384

config BUILD_OUTPUT_HEX
	default y

config UART_INTERRUPT_DRIVEN
	default y

endif
```

## boards/hpmicro/dust-hpm5e3y/dust-hpm5e3y_defconfig
```kconfig
CONFIG_CONSOLE=y
CONFIG_UART_CONSOLE=y
CONFIG_XIP=y
CONFIG_PINCTRL=y
CONFIG_GPIO=y
CONFIG_SERIAL=y
CONFIG_DMA=y
CONFIG_SPI=y
CONFIG_CAN=y
CONFIG_PWM=y
CONFIG_ETHERCAT_HPMICRO=y
CONFIG_NOCACHE_MEMORY=y
CONFIG_FLASH=y
```

## boards/hpmicro/dust-hpm6750/Kconfig
```kconfig
# Copyright (c) 2023 HPMicro
# SPDX-License-Identifier: BSD-3-Clause

if BOARD_DUST_HPM6750

config INIT_EXT_RAM
    bool "Initialize external RAM(SDRAM or DDR)"
    default n
    select HAS_HPMSDK_FEMC

config HPMICRO_BOARD_SUPPORT_EMMC
    bool "SUPPORT EMMC"
    default n
    help
      SUPPORT EMMC

endif # BOARD_DUST_HPM6750
```

## boards/hpmicro/dust-hpm6750/Kconfig.dust-hpm6750
```kconfig
# Copyright (c) 2022 HPMicro
# SPDX-License-Identifier: Apache-2.0

config BOARD_DUST_HPM6750
	select SOC_HPM6750
```

## boards/hpmicro/dust_5E31/Kconfig.dust_5E31
```kconfig
# SPDX-License-Identifier: Apache-2.0

config BOARD_DUST_5E31
	select SOC_HPM5E31
```

## boards/hpmicro/dust_5E31/dust_5E31_defconfig
```kconfig
CONFIG_CONSOLE=y
CONFIG_UART_CONSOLE=y
CONFIG_SERIAL=y
CONFIG_PINCTRL=y
CONFIG_UART_ASYNC_API=y
CONFIG_NOCACHE_MEMORY=y
CONFIG_XIP=y
CONFIG_FLASH=y
CONFIG_BUILD_OUTPUT_HEX=y
```

## drivers/can/Kconfig.hpmicro
```kconfig
# HPMICRO CASTCAN configuration options

# Copyright (c) 2022-2024 HPMicro
# SPDX-License-Identifier: Apache-2.0

DT_COMPAT_HPM_CAN := hpmicro,hpm-can

config CAN_HPMICRO
	bool "HPMICRO CAN driver"
	default y
	depends on CAN
	depends on DT_HAS_HPMICRO_HPM_CAN_ENABLED
    select HAS_HPMSDK_CAN
    help
        Enable the HPMICRO CAN driver

DT_COMPAT_HPM_MCAN := hpmicro,hpm-mcan

config MCAN_HPMICRO
	bool "HPMICRO MCAN driver"
	default y
	depends on CAN
	depends on DT_HAS_HPMICRO_HPM_MCAN_ENABLED
    select HAS_HPMSDK_MCAN
    help
        Enable the HPMICRO MCAN driver

config CAN_MAX_FILTER
	int "Maximum number of concurrent active filters"
	default 4
	range 1 16
	help
	  Maximum number of filters supported by the can_add_rx_callback() API call.

config HPM_MCAN_RX_TIMING
    bool "MCAN RX hardware timestamp and IRQ timing diagnostics"
    depends on MCAN_HPMICRO
    default n
    help
      Enable the internal 16-bit timestamp counter with 16 nominal CAN bit
      periods per tick. Save CPU IRQ-entry and counter-sampling cycles for
      the RX callback. Classic CAN diagnostic use only; no PDO ABI change.
```

## drivers/ethercat/Kconfig.hpmicro
```kconfig
# SPDX-License-Identifier: Apache-2.0
config HPM_ESC
    bool "HPMicro EtherCAT slave controller"
    default y
    depends on DT_HAS_HPMICRO_HPM_ESC_ENABLED
    depends on CLOCK_CONTROL && GPIO && PINCTRL
    help
      Enable the HPMicro ESC device and its clock, pins, reset GPIO and IRQs.

config HPM_ESC_PDRAM_WORD_ACCESS
    bool "Aligned 32-bit ESC process RAM transfers"
    depends on HPM_ESC && SOC_SERIES_HPM5E00
    default n
    help
      Use increasing aligned 32-bit accesses for process RAM blocks whose
      address and length are multiples of four. Register accesses and other
      lengths keep the existing path. No rounded reads or read-modify-writes.
      Disable to compare with the original byte transfer implementation.
```

## drivers/interrupt_controller/Kconfig.hpmicro
```kconfig
# Copyright (c) 2026 HPMicro
# SPDX-License-Identifier: Apache-2.0

config HPM_PLIC
	bool "HPMicro Platform Level Interrupt Controller"
	default y
	depends on DT_HAS_HPMICRO_HPM_PLIC_ENABLED
	select MULTI_LEVEL_INTERRUPTS
	select 2ND_LEVEL_INTERRUPTS
	help
	  HPMicro PLIC driver. This is API-compatible with Zephyr's RISC-V
	  PLIC support and can optionally allow higher-priority external IRQs
	  to preempt a lower-priority external IRQ handler.

if HPM_PLIC

config HPM_PLIC_PRIORITY_NESTING
	bool "Allow priority-based nesting of HPM PLIC interrupts"
	depends on !SMP
	help
	  While a PLIC ISR is running, raise the PLIC threshold to that ISR's
	  priority and re-enable machine interrupts. Only a strictly higher
	  priority PLIC source can then preempt it. Equal and lower priorities
	  remain pending. Keep this disabled until ISR stack size and all ISR
	  code have been audited for nesting.

config HPM_PLIC_MAX_NESTING_DEPTH
	int "Maximum simultaneous HPM PLIC ISR depth"
	default 4
	range 2 16
	depends on HPM_PLIC_PRIORITY_NESTING
	help
	  Maximum number of simultaneously active HPM PLIC handlers. At this
	  depth the current handler still runs, but machine interrupts remain
	  disabled so the ISR stack cannot grow without bound.

endif # HPM_PLIC
```

## drivers/serial/Kconfig.hpmicro
```kconfig
# Copyright (c) 2024 HPMicro
# SPDX-License-Identifier: Apache-2.0
DT_COMPAT_HPM_UART := hpmicro,hpm-uart

config UART_HPMICRO
	bool "HPMICRO serial driver"
	default y
	depends on DT_HAS_HPMICRO_HPM_UART_ENABLED
	select HAS_HPMSDK_UART
	select SERIAL_HAS_DRIVER
	select SERIAL_SUPPORT_INTERRUPT
	select SERIAL_SUPPORT_ASYNC
	select HAS_HPMSDK_GPTMR if SERIAL_SUPPORT_ASYNC
	select HAS_HPMSDK_DMA if (SERIAL_SUPPORT_ASYNC && DMA_HPMICRO)
	select HAS_HPMSDK_DMAV2 if (SERIAL_SUPPORT_ASYNC && DMAV2_HPMICRO)	
	select DMA if SERIAL_SUPPORT_ASYNC
	help
	  This option enables the UART driver for HPM SoC family.

config UART_HPMICRO_RX_NATIVE_IDLE
	bool "Native UART RX idle publication for partial async DMA buffers"
	default y if SOC_SERIES_HPM5E00
	depends on SOC_SERIES_HPM5E00 && UART_HPMICRO && UART_ASYNC_API && UART_INTERRUPT_DRIVEN
	help
	  Use the UART hardware RX idle detector and IIR2 status on HPM5E00.
	  uart_rx_enable timeout is rounded up to bit times (1..255 bits).
	  Unrepresentable finite timeouts fail; SYS_FOREVER_US disables idle.
	  No external GPTMR/TRGM detector or board-specific RX wiring is needed.

config UART_HPMICRO_RX_LINE_IDLE
	bool "UART10 partial RX publication by external line-idle detection"
	default y if BOARD_DUST_HPM6750
	depends on UART_HPMICRO && UART_ASYNC_API && UART_INTERRUPT_DRIVEN
	depends on !UART_HPMICRO_RX_NATIVE_IDLE
	help
	  Publish the partially filled UART10 RX DMA buffer after the RX line has
	  been idle for the configured interval. The Dust V3 DBUS RX signal reaches
	  UART10 RX/PC04 and PB13/TRGM1_P03; GPTMR2 channel 2 captures edges and
	  channel 0 provides the compare event. The board must provide the
	  uart10_idle_timer interrupt node. Do not enable on other wiring.
```

## dts/bindings/ethercat/hpmicro,hpm-esc.yaml
```yaml
# SPDX-License-Identifier: Apache-2.0

description: HPMicro EtherCAT slave controller

compatible: "hpmicro,hpm-esc"

include: [base.yaml, pinctrl-device.yaml]

properties:
  reg:
    required: true
  interrupts:
    required: true
  interrupt-names:
    required: true
  clocks:
    required: true
  phy-reset-gpios:
    type: phandle-array
    description: Active-low reset for the EtherCAT PHY.
  phy-addr-offset:
    type: int
    default: 0
    description: Address offset programmed into the ESC PHY management block.
  link0-ctrl-index:
    type: int
    default: 0
  link1-ctrl-index:
    type: int
    default: 0
  link2-ctrl-index:
    type: int
    default: 0
  port1-enabled:
    type: boolean
  port2-enabled:
    type: boolean
  port0-disabled:
    type: boolean
    description: Do not expose ESC port 0 when the board has no port 0 PHY.
  software-link0:
    type: boolean
    description: Use the GPR link state for port 0 instead of a dedicated LINK pin.
  software-link1:
    type: boolean
    description: Use the GPR link state for port 1 instead of a dedicated LINK pin.
  link0-invert:
    type: boolean
  link1-invert:
    type: boolean
  link2-invert:
    type: boolean
  run-error-leds:
    type: boolean
  run-led-ctrl-index:
    type: int
    default: 0
  error-led-ctrl-index:
    type: int
    default: 0
```

## dts/bindings/interrupt-controller/hpmicro,hpm-plic.yaml
```yaml
# Copyright (c) 2026 HPMicro
# SPDX-License-Identifier: Apache-2.0

description: HPMicro RISC-V platform-level interrupt controller

compatible: "hpmicro,hpm-plic"

include: riscv,plic0.yaml

properties:
  riscv,ndev:
    type: int
    description: Number of external interrupts supported
    required: true
```

## soc/hpmicro/HPM5E00/Kconfig
```kconfig
# Copyright (c) 2026
# SPDX-License-Identifier: Apache-2.0

config SOC_SERIES_HPM5E00
	select RISCV
	select RISCV_PRIVILEGED
	select RISCV_HAS_PLIC
	select DYNAMIC_INTERRUPTS

config SOC_HPM5E31
	bool
	select ATOMIC_OPERATIONS_C
	select INCLUDE_RESET_VECTOR
	select RISCV_ISA_EXT_M
	select RISCV_ISA_EXT_A
	select RISCV_ISA_EXT_C
	select RISCV_ISA_EXT_ZICSR
	select RISCV_ISA_EXT_ZIFENCEI
	select RISCV_ISA_RV32I
	select CPU_HAS_DCACHE
	select CPU_HAS_ICACHE
	select RISCV_PMP if !MCUBOOT

if SOC_SERIES_HPM5E00

config SOC_ANDES_V5_PMA
	bool "Andes V5 Physical Memory Attribute (PMA)"
	default y
	select ARCH_HAS_NOCACHE_MEMORY_SUPPORT
	select HAS_HPMSDK_PMP

endif
```

## soc/hpmicro/HPM5E00/Kconfig.defconfig.HPM5E31
```kconfig
# SPDX-License-Identifier: Apache-2.0

if SOC_HPM5E31

config SYS_CLOCK_TICKS_PER_SEC
	default 1000

config ISR_STACK_SIZE
	default 2048

config MAIN_STACK_SIZE
	default 4096

endif
```

## soc/hpmicro/HPM5E00/Kconfig.soc
```kconfig
# Copyright (c) 2026
# SPDX-License-Identifier: Apache-2.0

config SOC_SERIES_HPM5E00
	bool
	select SOC_FAMILY_HPM
	select HAS_HPMSDK_PLLCTLV2
	select HAS_HPMSDK_PCFG
	help
	  Enable support for HPMicro HPM5E00 series SoCs.

config SOC_SERIES
	default "HPM5E00" if SOC_SERIES_HPM5E00

config SOC_HPM5E31
	bool
	select SOC_SERIES_HPM5E00

config SOC
	default "HPM5E31" if SOC_HPM5E31
```
